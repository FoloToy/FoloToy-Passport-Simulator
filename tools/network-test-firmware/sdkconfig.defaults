## tools/network-test-firmware/sdkconfig.defaults
```kconfig
CONFIG_IDF_TARGET="esp32c3"
CONFIG_EXAMPLE_CONNECT_WIFI=y
CONFIG_EXAMPLE_CONNECT_ETHERNET=n
CONFIG_EXAMPLE_CONNECT_IPV6=n
CONFIG_EXAMPLE_WIFI_SSID="Emulator Host Bridge"
CONFIG_EXAMPLE_WIFI_PASSWORD=""
CONFIG_EXAMPLE_WIFI_AUTH_OPEN=y
CONFIG_ESP_CONSOLE_UART_DEFAULT=y
```
